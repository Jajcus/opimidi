/dts-v1/;
/plugin/;
/ {
	compatible = "xunlong,orangepi-zero", "allwinner,sun8i-h2plus", "allwinner,sun8i-h3";

	fragment0 {
		target = <&xr819wifi>;
		__overlay__ {
		    status = "disabled";
		};
	};
	fragment1 {
		target = <&mmc1>;
		__overlay__ {
		    status = "disabled";
		};
	};
};


// vi: sw=4 sts=4 et
